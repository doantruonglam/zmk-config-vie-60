## config/boards/arm/vie60/Kconfig.board
```kconfig
# Zaphod board configuration

# Copyright (c) 2020 Pete Johanson
# SPDX-License-Identifier: MIT

config BOARD_VIE60
	bool "Vie60"
	depends on SOC_NRF52840_QIAA
```

## config/boards/arm/vie60/vie60_defconfig
```kconfig
# SPDX-License-Identifier: MIT

CONFIG_SOC_SERIES_NRF52X=y
CONFIG_SOC_NRF52840_QIAA=y
CONFIG_BOARD_VIE60=y

# Enable MPU
CONFIG_ARM_MPU=y

# enable GPIO
CONFIG_GPIO=y

CONFIG_ZMK_SLEEP=n

CONFIG_USE_DT_CODE_PARTITION=y

CONFIG_MPU_ALLOW_FLASH_WRITE=y
CONFIG_NVS=y
CONFIG_SETTINGS_NVS=y
CONFIG_FLASH=y
CONFIG_FLASH_PAGE_LAYOUT=y
CONFIG_FLASH_MAP=y

# Uncomment to enable encoder
CONFIG_EC11=y
CONFIG_EC11_TRIGGER_GLOBAL_THREAD=y
CONFIG_ZMK_RGB_UNDERGLOW=y

# Use the STRIP config specific to the LEDs you're using
CONFIG_WS2812_STRIP=y
CONFIG_BUILD_OUTPUT_UF2=y
CONFIG_ZMK_RGB_UNDERGLOW_HUE_START=160
CONFIG_ZMK_RGB_UNDERGLOW_EFF_START=3
CONFIG_ZMK_EXT_POWER=y
CONFIG_ZMK_RGB_UNDERGLOW_EXT_POWER=y
CONFIG_ZMK_RGB_UNDERGLOW_ON_START=y

# Uncomment the following lines to enable the Corne RGB Underglow
CONFIG_ZMK_RGB_UNDERGLOW=y
CONFIG_WS2812_STRIP=y

# 0	Solid color
# 1	Breathe
# 2	Spectrum
# 3	Swirl
# 4	Status
CONFIG_ZMK_RGB_UNDERGLOW_EFF_START=4

# Status LEDs
CONFIG_ZMK_RGB_UNDERGLOW_STATUS_BATTERY_N=5
CONFIG_ZMK_RGB_UNDERGLOW_STATUS_LAYER_N=13
CONFIG_ZMK_RGB_UNDERGLOW_STATUS_CAPS_N=25
CONFIG_ZMK_RGB_UNDERGLOW_STATUS_BATTERY_COLOR_MIN=0
CONFIG_ZMK_RGB_UNDERGLOW_STATUS_BATTERY_COLOR_MAX=160
CONFIG_ZMK_RGB_UNDERGLOW_STATUS_CAPS_COLOR=320

# Turn off RGB underglow when keyboard goes into idle state
CONFIG_ZMK_RGB_UNDERGLOW_AUTO_OFF_IDLE=y
```

## config/west.yml
```yaml
manifest:
  remotes:
    - name: zmkfirmware
      url-base: https://github.com/Xoffio/
  projects:
    - name: zmk
    
      remote: zmkfirmware
      revision: main

      import: app/west.yml
  self:
    path: config
```
